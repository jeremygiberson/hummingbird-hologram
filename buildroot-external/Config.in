## buildroot-external/configs/hologram_defconfig
```kconfig
# Hologram Hummingbird — Buildroot defconfig for Raspberry Pi Zero 2 W
#
# Usage:
#   make BR2_EXTERNAL=/path/to/hologram/buildroot-external hologram_defconfig
#   make
#
# Output: output/images/sdcard.img

# --- Architecture ---
BR2_aarch64=y

# --- Toolchain ---
BR2_TOOLCHAIN_BUILDROOT_GLIBC=y
BR2_PACKAGE_HOST_LINUX_HEADERS_CUSTOM_6_6=y

# --- Target ---
BR2_LINUX_KERNEL=y
BR2_LINUX_KERNEL_CUSTOM_TARBALL=y
BR2_LINUX_KERNEL_DEFCONFIG="bcm2711"
BR2_LINUX_KERNEL_DTS_SUPPORT=y
BR2_LINUX_KERNEL_INTREE_DTS_NAME="broadcom/bcm2710-rpi-zero-2-w"
BR2_LINUX_KERNEL_NEEDS_HOST_OPENSSL=y

# --- Bootloader (RPi firmware) ---
BR2_PACKAGE_RPI_FIRMWARE=y
BR2_PACKAGE_RPI_FIRMWARE_VARIANT_PI=y

# --- Filesystem ---
BR2_TARGET_ROOTFS_EXT2=y
BR2_TARGET_ROOTFS_EXT2_4=y
BR2_TARGET_ROOTFS_EXT2_SIZE="128M"
BR2_ROOTFS_POST_IMAGE_SCRIPT="board/raspberrypi/post-image.sh"
BR2_ROOTFS_POST_SCRIPT_ARGS="--add-miniuart-bt-overlay --aarch64"

# --- Init ---
BR2_INIT_BUSYBOX=y
BR2_ROOTFS_OVERLAY=""

# --- System ---
BR2_SYSTEM_DHCP="eth0"
BR2_TARGET_GENERIC_GETTY_PORT="ttyAMA0"

# --- Graphics: Mesa VC4 + DRM/KMS ---
BR2_PACKAGE_MESA3D=y
BR2_PACKAGE_MESA3D_GALLIUM_DRIVER_VC4=y
BR2_PACKAGE_MESA3D_GALLIUM_DRIVER_V3D=y
BR2_PACKAGE_MESA3D_OPENGL_ES=y
BR2_PACKAGE_MESA3D_OPENGL_EGL=y
BR2_PACKAGE_LIBDRM=y

# --- SDL2 with KMSDRM backend ---
BR2_PACKAGE_SDL2=y
BR2_PACKAGE_SDL2_KMSDRM=y
BR2_PACKAGE_SDL2_OPENGL=y
BR2_PACKAGE_SDL2_OPENGLES=y
BR2_PACKAGE_SDL2_ALSA=y
BR2_PACKAGE_SDL2_X11=n

# --- Audio ---
BR2_PACKAGE_ALSA_LIB=y
BR2_PACKAGE_ALSA_UTILS=y

# --- Hologram app ---
BR2_PACKAGE_HOLOGRAM=y

# --- Trim unnecessary packages ---
BR2_PACKAGE_BUSYBOX_SHOW_OTHERS=y
BR2_SYSTEM_BIN_SH_BUSYBOX=y

# --- No X11, no Wayland, no desktop ---
# BR2_PACKAGE_XORG7=n  (not set by default)
# BR2_PACKAGE_WESTON=n  (not set by default)
```
